## conf/layer.conf
```bitbake
# We have a conf and classes directory, add to BBPATH
BBPATH .= ":${LAYERDIR}"

# We have recipes-* directories, add to BBFILES
BBFILES += "${LAYERDIR}/recipes-*/*/*.bb \
            ${LAYERDIR}/recipes-*/*/*.bbappend"

BBFILE_COLLECTIONS += "meta-aaeon-qcom"
BBFILE_PATTERN_meta-aaeon-qcom = "^${LAYERDIR}/"
BBFILE_PRIORITY_meta-aaeon-qcom = "9"

LAYERDEPENDS_meta-aaeon-qcom = "core"
LAYERSERIES_COMPAT_meta-aaeon-qcom = "scarthgap"
```
